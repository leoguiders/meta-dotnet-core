## conf/layer.conf
```bitbake
# We have a conf and classes directory, add to BBPATH
BBPATH .= ":${LAYERDIR}"

# We have recipes-* directories, add to BBFILES
BBFILES += "${LAYERDIR}/recipes-*/*/*.bb \
	${LAYERDIR}/recipes-*/*/*.bbappend"

BBFILE_COLLECTIONS += "dotnet-core"
BBFILE_PATTERN:dotnet-core = "^${LAYERDIR}/"
BBFILE_PRIORITY:dotnet-core = "6"
LAYERDEPENDS:dotnet-core = "core openembedded-layer perl-layer meta-python networking-layer security"
LAYERSERIES_COMPAT:dotnet-core = "honister kirkstone"

LICENSE_PATH += "${LAYERDIR}/licenses"
PREFERRED_RPROVIDER:dotnet-core = "dotnet-core"
```
